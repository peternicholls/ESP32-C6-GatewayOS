## sdkconfig.defaults
```kconfig
# ESP32-C6 Configuration
CONFIG_IDF_TARGET="esp32c6"

# Zigbee Configuration
CONFIG_ZB_ENABLED=y
CONFIG_ZB_RADIO_MODE_NATIVE=y

# Wi-Fi Configuration
CONFIG_ESP_WIFI_ENABLED=y

# FreeRTOS Configuration
CONFIG_FREERTOS_HZ=1000
CONFIG_FREERTOS_USE_TRACE_FACILITY=y
CONFIG_FREERTOS_GENERATE_RUN_TIME_STATS=y

# MQTT Configuration
CONFIG_MQTT_PROTOCOL_311=y

# Partition Configuration
CONFIG_PARTITION_TABLE_CUSTOM=y
CONFIG_PARTITION_TABLE_CUSTOM_FILENAME="partitions.csv"

# NVS Configuration
CONFIG_NVS_ENCRYPTION=y

# Logging Configuration
CONFIG_LOG_DEFAULT_LEVEL_INFO=y
CONFIG_LOG_COLORS=y
```
